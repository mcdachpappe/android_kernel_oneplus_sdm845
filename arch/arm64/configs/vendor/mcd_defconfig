## drivers/set_androidver/Kconfig
```kconfig
config SET_ANDROIDVER
	bool "Set the android version with anykernel"
	default y

config UNIFIED
	bool "Make source UNIFIED"
	default y
```

## drivers/set_androidversion/Kconfig
```kconfig
config SET_ANDROIDVERSION
	bool "Detect the Android version with Anykernel"
	default y

config UNIFIED
	bool "Make source Unified"
	default y
```

## drivers/set_os/Kconfig
```kconfig
config SET_OS
	bool "Set the OS with anykernel"
	default y

config UNIFIED
	bool "Make source UNIFIED"
	default y
```
